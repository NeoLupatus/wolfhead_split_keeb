## boards/shields/wolfhead_split/Kconfig.defconfig
```kconfig
if SHIELD_WOLFHEAD_SPLIT_LEFT

config ZMK_KEYBOARD_NAME
    default "wolfhead_split"

config ZMK_SPLIT_ROLE_CENTRAL
    default y

endif # SHIELD_WOLFHEAD_SPLIT_LEFT

if SHIELD_WOLFHEAD_SPLIT_LEFT || SHIELD_WOLFHEAD_SPLIT_RIGHT

config ZMK_SPLIT
    default y

endif # SHIELD_WOLFHEAD_SPLIT_LEFT || SHIELD_WOLFHEAD_SPLIT_RIGHT
```

## boards/shields/wolfhead_split/Kconfig.shield
```kconfig
config SHIELD_WOLFHEAD_SPLIT_LEFT
    def_bool $(shields_list_contains,wolfhead_split_left)

config SHIELD_WOLFHEAD_SPLIT_RIGHT
    def_bool $(shields_list_contains,wolfhead_split_right)
```
